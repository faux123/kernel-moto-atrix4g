## arch/arm/mach-tegra/odm_kit/Kconfig
```kconfig
choice
	prompt "Select ODM kit target board"

config TEGRA_ODM_HARMONY
	bool "NVIDIA Tango or Harmony development system"
	depends on ARCH_TEGRA_2x_SOC && MACH_TEGRA_GENERIC

config TEGRA_ODM_VENTANA
	bool "NVIDIA Ventana development system"
	depends on ARCH_TEGRA_2x_SOC && MACH_TEGRA_GENERIC

config TEGRA_ODM_WHISTLER
	bool "NVIDIA Whistler development system"
	depends on ARCH_TEGRA_2x_SOC && MACH_TEGRA_GENERIC

config TEGRA_ODM_ETNA
	bool "Motorola ETNA brassboard/phone"
	depends on ARCH_TEGRA_2x_SOC

config TEGRA_ODM_SUNFIRE
	bool "Motorola SUNFIRE phone"
	depends on ARCH_TEGRA_2x_SOC

config TEGRA_ODM_DAYTONA
	bool "Motorola DAYTONA phone"
	depends on ARCH_TEGRA_2x_SOC

config TEGRA_ODM_OLYMPUS
	bool "Motorola OLYMPUS brassboard/phone"
	depends on ARCH_TEGRA_2x_SOC

endchoice
```

## drivers/misc/pnx6718_mux/Kconfig
```kconfig
menuconfig MOT_FEAT_TD_TS27010MUX
	bool "TD-SCDMA modem MUX Support"
	default y
	help
	  Say Y here to enable TD-SCDMA modem MUX support.
```

## drivers/misc/sec/Kconfig
```kconfig
#
# Sec configuration
#

menu "Motorola sec driver"

config MOT_SEC_DRIVER
	tristate "Motorola sec driver"
	default n

endmenu
```

## drivers/net/usb/qcusbnet/Kconfig
```kconfig
#
# QMI configuration
#

menu "Motorola QMI Net driver"

config QCUSBNET
        tristate "Motorola MUX QMI driver"
	depends on USB_USBNET
        default n

endmenu
```

## drivers/net/wireless/bcm4329/Kconfig
```kconfig
config BCM4329
	tristate "BCM4329 wireless support"
#	depends on WLAN_80211
	select WIRELESS_EXT
	---help---
	  This is a driver for the Broadcom 4329 wireless chip.

config BCM4329_DEBUG
	bool "Debug"
	default n
	depends on BCM4329

config BCM4329_GPIO_BT_RESET
	int "GPIO BT_RESET"
	default 164
	depends on BCM4329

config BCM4329_GPIO_WL_RESET
	int "GPIO WL_RESET"
	default 162
	depends on BCM4329

config BRCM_WL_HOSTWAKEUP
	bool "Support BCM4325/BCM4329 Host Wakeup function"
	default n
	depends on BCM4329
	
config BRCM_WL_PKTFILTER
	bool "Setting Multicat/Broadcast packet fillter."
	default n
	depends on BCM4329

config BRCM_WL_ARPOFFLOAD
	bool "Use Arp offload function."
	default n
	depends on BCM4329

config BRCM_GPIO_INTR
	bool "Use Broadcom Host Wakeup GPIO"
	default n
	depends on BCM4329
	---help---
	   This function is activated only if set CONFIG_HAS_EARLYSUSPEND.	

config BCM4329_GPIO_WL_HOSTWAKEUP
	int "GPIO WL_HOSTWAKEUP"
	default 165
	depends on BCM4329

config BRCM_USE_SOFTAP
	bool "Use SoftAP"
	default n
	depends on BCM4329
	---help---
	   Using Softap feature.

config BCM4329_GPIO_WL_REGON
	int "GPIO WL_REGON"
	default 163
	depends on BCM4329
```

## drivers/smsmdtv/Kconfig
```kconfig
#
# Siano Mobile Silicon Digital TV device configuration
#

menu "Sms2186 Driver"

comment "SMSx186 Drivers"

config SIANO_MDTV
	tristate "Siano SMSx186 based Mobile TV receiver"
	depends on TEGRA_ODM_AROWANA
	default y
	---help---
	  Choose Y or M here if you have MDTV receiver with a Siano chipset.

	  To compile this driver as a module, choose M here
	  (The module will be called smsmdtv).

	  Further documentation on this driver can be found on the WWW
	  at http://www.siano-ms.com/

endmenu
```

## drivers/smspower/Kconfig
```kconfig
menu "CMMB_POWER"

comment "SMSx186 power"

config CMMB_POWER
	bool "enable CMMB Power"
	depends on TEGRA_ODM_AROWANA
	default y
	---help---
	  Choose y or m here if you want to build-in or make it as module.
endmenu
```
